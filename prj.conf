## CMakeLists.txt
```
cmake_minimum_required(VERSION 3.20.0)


set(BOARD nucleo_f413zh)

find_package(Zephyr)
project(my_zephyr_app)

target_sources(app PRIVATE 
    src/main.cpp
    src/max31856.cpp)
```

## prj.conf
```kconfig
CONFIG_CPP=y
CONFIG_SPI=y
CONFIG_FPU=y
```

## src/main.cpp
```c
#include <zephyr/kernel.h>
#include <zephyr/drivers/spi.h>
#include <zephyr/drivers/gpio.h>
#include "max31856.h"
#define SPI1_DEV    DT_NODELABEL(spi1)
#define GPIOD_DEV     DT_NODELABEL(gpiod)
#define BUTTON_NODE   DT_ALIAS(sw0)

static const struct gpio_dt_spec button = GPIO_DT_SPEC_GET(BUTTON_NODE, gpios);

const struct device *const spi1_dev = DEVICE_DT_GET(SPI1_DEV);

const struct device *const gpiod_dev = DEVICE_DT_GET(GPIOD_DEV);

struct gpio_callback cb_data;

int main(){

    if(device_is_ready(gpiod_dev)){
        printf("GPIOD Ready!\n");
    }

    if(device_is_ready(spi1_dev)){
        printf("SPI1 Ready!\n");
    }
    printf("Config Done!\n");
    max31856 sensor(spi1_dev, gpiod_dev,14,0b10110110,0b00010110) ;


    while(1){
        float result;
        sensor.readTemperature(&result);

        printf("Temperature: %3.2f\n", result);
        sensor.readColdJunction(&result);
    
        printf("Cold Junction: %3.2f\n", result);

        k_sleep(K_SECONDS(1));
    }

    return 0;
}
```

## src/max31856.cpp
```c
#include "max31856.h"
#include <zephyr/drivers/spi.h>
#include <zephyr/drivers/gpio.h>

struct spi_config config = {
    .frequency = 500000,
    .operation = SPI_OP_MODE_MASTER | SPI_TRANSFER_MSB | SPI_WORD_SET(8) | SPI_MODE_CPHA,
    .slave = 0,
    .cs = NULL,
};

max31856::max31856(const device *spi_dev, const device *gpio_dev, gpio_pin_t cs_pin, uint8_t CR0_config, uint8_t CR1_config)
{
    max31856::spi_dev = spi_dev;
    max31856::gpio_dev = gpio_dev;
    max31856::pin = cs_pin;
    max31856::CR0_config = CR0_config;
    max31856::CR1_config = CR1_config;
    gpio_pin_configure(gpio_dev,cs_pin, GPIO_OUTPUT_INACTIVE | GPIO_ACTIVE_LOW);
    write(MAX31856_CR0_REG, CR0_config);
    write(MAX31856_CR1_REG, CR1_config);
    
}

max31856::~max31856()
{
}

int max31856::write(uint8_t reg, uint8_t val)
{
    uint8_t data[2] = {reg | MAX31856_RD_WR_BIT, val};

    struct spi_buf tx_buf = {
        .buf = &data,
        .len = sizeof(data)};
    struct spi_buf_set tx_buf_set = {
        .buffers = &tx_buf,
        .count = 1};
    gpio_pin_set(gpio_dev, pin, 1);

    int ret = spi_write(max31856::spi_dev, &config, &tx_buf_set);
    gpio_pin_set(gpio_dev, pin, 0);
    return ret;
}

int max31856::read(uint8_t reg, uint8_t *result)
{
    uint8_t data[1] = {reg};
    uint8_t datarx[1];

    struct spi_buf tx_buf = {
        .buf = data,
        .len = sizeof(data)};
    struct spi_buf rx_buf = {
        .buf = datarx,
        .len = sizeof(datarx)};

    struct spi_buf_set tx_buf_set = {
        .buffers = &tx_buf,
        .count = 1};
    struct spi_buf_set rx_buf_set = {
        .buffers = &rx_buf,
        .count = 1};
    gpio_pin_set(gpio_dev, 14, 1);
    int ret = spi_write(spi_dev, &config, &tx_buf_set);
    ret = spi_read(spi_dev, &config, &rx_buf_set);
    gpio_pin_set(gpio_dev, pin, 0);

    *result = datarx[0];
    return ret;
}

int max31856::readTemperature(float *result)
{
    uint8_t HB;
    uint8_t MB;
    uint8_t LB;
    int ret = read(MAX31856_LTCBH_REG, &HB);
    ret = read(MAX31856_LTCBM_REG, &MB);
    ret = read(MAX31856_LTCBL_REG, &LB);

    printf("%02x,%02x,%02x\n", HB,MB,LB);
    
    int32_t i = (HB << 16) | (MB<<8) | (LB);
    i >>= 5;
    if(HB & 0x80){
        i -= 0x80000;
    }
    *result = i/128.f;
    return 0;
}

int max31856::readColdJunction(float *result)
{
    uint8_t HB;
    uint8_t LB;
    int ret = read(MAX31856_CJTH_REG, &HB);
    ret = read(MAX31856_CJTL_REG, &LB);

    int16_t i = (HB << 8) | (LB);

    i >>= 2;
    if(HB & 0x80){
        i -= 0x800;
    }
    *result = i/64.f;

    return 0;
}
```

## src/max31856.h
```c
#include <zephyr/drivers/spi.h>
#include <zephyr/drivers/gpio.h>
#include <zephyr/kernel.h>

#define MAX31856_RD_WR_BIT         BIT(7)
#define MAX31856_CR0_AUTOCONVERT   BIT(7)
#define MAX31856_CR0_1SHOT         BIT(6)
#define MAX31856_CR0_OCFAULT       BIT(4)
#define MAX31856_CR0_OCFAULT_MASK  GENMASK(5, 4)
#define MAX31856_CR0_FILTER_50HZ   BIT(0)
#define MAX31856_AVERAGING_MASK    GENMASK(6, 4)
#define MAX31856_AVERAGING_SHIFT   4
#define MAX31856_TC_TYPE_MASK      GENMASK(3, 0)
#define MAX31856_FAULT_OVUV        BIT(1)
#define MAX31856_FAULT_OPEN        BIT(0)
/* The MAX31856 registers */
#define MAX31856_CR0_REG           0x00
#define MAX31856_CR1_REG           0x01
#define MAX31856_MASK_REG          0x02
#define MAX31856_CJHF_REG          0x03
#define MAX31856_CJLF_REG          0x04
#define MAX31856_LTHFTH_REG        0x05
#define MAX31856_LTHFTL_REG        0x06
#define MAX31856_LTLFTH_REG        0x07
#define MAX31856_LTLFTL_REG        0x08
#define MAX31856_CJTO_REG          0x09
#define MAX31856_CJTH_REG          0x0A
#define MAX31856_CJTL_REG          0x0B
#define MAX31856_LTCBH_REG         0x0C
#define MAX31856_LTCBM_REG         0x0D
#define MAX31856_LTCBL_REG         0x0E
#define MAX31856_SR_REG            0x0F


class max31856
{
private:
    const device* spi_dev;
    const device* gpio_dev;
    int pin;
    uint8_t CR0_config;
    uint8_t CR1_config;
    
public:
    max31856(const device *spi_dev, const device *gpio_dev, gpio_pin_t pin, uint8_t CR0_config, uint8_t CR1_config);
    ~max31856();
    int write(uint8_t reg, uint8_t val);
    int read(uint8_t reg, uint8_t *result);

    int readTemperature(float *result);
    int readColdJunction(float *result);


};
```
